/**
 *
 * @cliArgs --board "/boards/LAUNCHXL_F28P65X" --device "F28P65x" --part "F28P65x_169NMR" --package "169NMR" --context "CPU1" --product "C2000WARE@26.02.00.00"
 * @versions {"tool":"1.28.1+4785"}
 */

/**
 * Import the modules used in this configuration.
 */
const led  = scripting.addModule("/driverlib/board_components/led", {}, false);
const led1 = led.addInstance();
const led2 = led.addInstance();
const sci  = scripting.addModule("/driverlib/sci.js", {}, false);
const sci1 = sci.addInstance();

/**
 * Write custom configuration values to the imported modules.
 */
led1.$name     = "myBoardLED0";
led1.$hardware = system.deviceData.board.components.LED4;

led2.$name     = "myBoardLED1";
led2.$hardware = system.deviceData.board.components.LED5;

sci1.$name         = "mySCI0";
sci1.$hardware     = system.deviceData.board.components.XDS_UART.subComponents.XDS_SCI_INST1;
sci1.rxFifo        = "SCI_FIFO_RX1";
sci1.useInterrupts = false;
sci1.rxQual.$name  = "myGPIOQUAL0";
sci1.txQual.$name  = "myGPIOQUAL1";

/**
 * Pinmux solution for unlocked pins/peripherals. This ensures that minor changes to the automatic solver in a future
 * version of the tool will not impact the pinmux you originally saw.  These lines can be completely deleted in order to
 * re-solve from scratch.
 */
led1.gpio.gpioPin.$suggestSolution  = "boosterpack1.13";
led2.gpio.gpioPin.$suggestSolution  = "boosterpack2.53";
sci1.sci.$suggestSolution           = "SCIA";
sci1.sci.sci_rxPin.$suggestSolution = "boosterpack1.3";
sci1.sci.sci_txPin.$suggestSolution = "boosterpack1.4";
